

#include <ESP8266WiFi.h>

const char* ssid = "wifi-name";           // Chage to wifi name
const char* password = "wifi-password";     // change to wifi password

int ledPin = D5;
int pinState = LOW;

// The certificate is stored in PMEM
static const uint8_t x509[] PROGMEM = {
  0x30, 0x82, 0x01, 0x4b, 0x30, 0x81, 0xf6, 0x02, 0x09, 0x00, 0xf4, 0xc4,
  0x59, 0xc2, 0x53, 0x70, 0x30, 0x6f, 0x30, 0x0d, 0x06, 0x09, 0x2a, 0x86,
  0x48, 0x86, 0xf7, 0x0d, 0x01, 0x01, 0x0b, 0x05, 0x00, 0x30, 0x2d, 0x31,
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  0x59, 0xa5, 0xb6, 0x21, 0x89, 0xfe, 0x4a, 0x3f, 0x24, 0x47, 0x7e
};

// And so is the key.  These could also be in DRAM
static const uint8_t rsakey[] PROGMEM = {
  0x30, 0x82, 0x01, 0x3b, 0x02, 0x01, 0x00, 0x02, 0x41, 0x00, 0x9f, 0x67,
  0xa4, 0xb6, 0x58, 0x64, 0xc7, 0x1d, 0x10, 0x66, 0x2c, 0x97, 0xed, 0x24,
  0x39, 0x4a, 0xca, 0xd7, 0x93, 0xda, 0x82, 0x6c, 0x12, 0xdc, 0x8f, 0x99,
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  0xe0, 0x55, 0x97, 0x0b, 0xe5, 0x83, 0xde
};

// Create an instance of the server
// specify the port to listen on as an argument


//WiFiServerSecure server(443); HTTPS
WiFiServer server(80);

 
void setup() {
  Serial.begin(9600);
  delay(10); 
  pinMode(ledPin, OUTPUT);
  
  digitalWrite(ledPin, !pinState);  
}
 
void loop() {
  
  // Connect to WiFi network
  if (WiFi.status() != WL_CONNECTED){
    Serial.println();
    Serial.println();
    Serial.print("Connecting to ");
    Serial.println(ssid);
  
    WiFi.begin(ssid, password);
  
    while (WiFi.status() != WL_CONNECTED) {
      delay(500);
      Serial.print(".");
    }
    // Set the certificates from PMEM (if using DRAM remove the _P from the call)
    
   // server.setServerKeyAndCert_P(rsakey, sizeof(rsakey), x509, sizeof(x509)); HTTPS
  
    Serial.println("");
    Serial.println("WiFi connected");
   
    // Start the server
    server.begin();
    Serial.println("Server started");
   
    // Print the IP address
    Serial.print("Use this URL : ");
    Serial.print("http://");
    Serial.print(WiFi.localIP());
    Serial.println("/");  
  }
  


  
  // Check if a client has connected
  //WiFiClientSecure client = server.available(); HTTPS
  WiFiClient client = server.available(); 
  if (!client) {
    return;
  }
 
  // Wait until the client sends some data
  Serial.println("new client");
  unsigned long timeout = millis() + 1000;
  while (!client.available() && millis() < timeout) {
    delay(1);
  }
  if (millis() > timeout) {
    Serial.println("timeout");
    client.flush();
    client.stop();
    return;
  }
 
  // Read the first line of the request
  String request = client.readStringUntil('\r');
  Serial.println(request);
  client.flush();
 
  // Match the request
 
  
  if (request.indexOf("/LED=ON") != -1) {
    pinState = HIGH;
    digitalWrite(ledPin, !pinState);
  }
  else if (request.indexOf("/LED=OFF") != -1) {
    pinState = LOW;
    digitalWrite(ledPin, !pinState);
  }
  else {
    // same state as befor, to get the status of the pin
  }
 // else {
 //   Serial.println("invalid request");
 //   client.print("HTTP/1.1 404 Not Found\r\nContent-Type: text/html\r\n\r\n<!DOCTYPE HTML>\r\n<html><body>Not found</body></html>");
 //   return;


   // Prepare the response
  String s = "HTTP/1.1 200 OK\r\nContent-Type: text/html\r\n\r\n<!DOCTYPE HTML>\r\n<html>\r\nGPIO is now: ";
  s += (pinState) ? "On<br/>Click <a href=\"/LED=OFF\">here</a> Turn relay OFF<br>" : "Off<br/>Click <a href=\"/LED=ON\">here</a> Turn relay ON<br>";
  s += "</html>";


 // Send the response to the client
  client.print(s);



  Serial.println("Client disconnected");
  Serial.println("");
  delay(1);
}
